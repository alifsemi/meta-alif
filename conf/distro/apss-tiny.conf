## conf/distro/apss-tiny.conf
```bitbake
# Copyright (C) 2023 Alif Semiconductor - All Rights Reserved.
# Use, distribution and modification of this code is permitted under the
# terms stated in the Alif Semiconductor Software License Agreement
#
# You should have received a copy of the Alif Semiconductor Software
# License Agreement with this file. If not, please write to:
# contact@alifsemi.com, or visit: https://alifsemi.com/license

# Use custom local.conf.sample before it is used from oe-core.
SANITY_LOCALCONF_SAMPLE = "${ALIFBASE}/conf/local.conf.sample"

require conf/distro/poky-tiny.conf

DISTRO_NAME = "Alif Iota - Tiny Linux Distribution"
DISTRO = "iota-tiny"
DISTRO_VERSION = "0.1"
TCLIBC = "musl"
DISTRO = "apss-tiny"
INHERIT_append += "image-buildinfo own-mirrors dct aes"
BB_GENERATE_MIRROR_TARBALLS = "1"
DISTROOVERRIDES .= ":apss-tiny"

# enable mdev/busybox for init
VIRTUAL-RUNTIME_dev_manager = "busybox-mdev"
VIRTUAL-RUNTIME_login_manager = "busybox"
VIRTUAL-RUNTIME_init_manager = "busybox"
VIRTUAL-RUNTIME_initscripts = "initscripts"
VIRTUAL-RUNTIME_keymaps = "keymaps"
DISTRO_FEATURES_BACKFILL_CONSIDERED += "sysvinit"

IMAGE_LINGUAS = " "
IMAGE_FEATURES += "debug-tweaks"
IMAGE_CLASSES += "cramfs-xip"
IMAGE_FSTYPES = "tar.bz2 ext4 cramfs-xip"

MACHINE_EXTRA_RDEPENDS += "kernel-module-cdc kernel-module-d2d"
EXTRA_IMAGEDEPENDS_append = " trusted-firmware-a a32-linux-dd-testcases"


# Ship static libraries into SDK, this makes binaries link (via -static option)
# to static libaries (.a) which significantly reduce the binary size
# rather than copying huge shared library (.so) to RFS.
SDKIMAGE_FEATURES_append += "staticdev-pkgs"


# make MHU as part of default kernel config as it is
# needed for programming the OSPI1 flash.
DISTRO_FEATURES_append += "apss-mhu apss-hwsem"

# set BASE_IMAGE to 1 to include SD share, USB, I2C, SPI, Debug, and CRC.
DISTRO_FEATURES_append += "${@bb.utils.contains('BASE_IMAGE', '1', 'apss-sd-share apss-usb apss-i2c apss-spi apss-debug apss-crc', '', d)}"

# ship statically linked gdbserver to reduce size of cramfs-xip
STATIC_GDBSERVER ?= "1"

#FEATURE_PACKAGES_apss-graphics = "packagegroup-apss-graphics"
#MACHINE_EXTRA_RDEPENDS += "${@bb.utils.contains('DISTRO_FEATURES', 'apss-graphics', 'kernel-module-cdc kernel-module-d2d', '', d)}"

# DCT JSON file
DCT_JSON_FILE ?= ""

# AES encryption
IMAGE_POSTPROCESS_COMMAND_append += "${@bb.utils.contains('AES_EN','1','aes_enc_rootfs;','',d)}"
```

## conf/distro/bolt-tiny.conf
```bitbake
require conf/distro/poky-tiny.conf

DISTRO_NAME = "Alif Iota - Tiny Linux Distribution"
DISTRO = "iota-tiny"
DISTRO_VERSION = "0.1"
TCLIBC = "musl"
DISTRO = "bolt-tiny"
INHERIT_append += "image-buildinfo own-mirrors"
BB_GENERATE_MIRROR_TARBALLS = "1"
DISTROOVERRIDES .= ":bolt-tiny"

IMAGE_LINGUAS = " "
IMAGE_FEATURES += "debug-tweaks"
IMAGE_CLASSES += "cramfs-xip"
IMAGE_FSTYPES = "tar.bz2 ext4 cramfs-xip"

MACHINE_EXTRA_RDEPENDS += "kernel-module-cdc kernel-module-d2d"
EXTRA_IMAGEDEPENDS_append = " trusted-firmware-a a32-linux-dd-testcases"



#FEATURE_PACKAGES_bolt-graphics = "packagegroup-bolt-graphics"
#MACHINE_EXTRA_RDEPENDS += "${@bb.utils.contains('DISTRO_FEATURES', 'bolt-graphics', 'kernel-module-cdc kernel-module-d2d', '', d)}"
```

## conf/layer.conf
```bitbake
# Copyright (C) 2022 Alif Semiconductor - All Rights Reserved.
# Use, distribution and modification of this code is permitted under the
# terms stated in the Alif Semiconductor Software License Agreement
#
# You should have received a copy of the Alif Semiconductor Software
# License Agreement with this file. If not, please write to:
# contact@alifsemi.com, or visit: https://alifsemi.com/license

# We have a conf and classes directory, add to BBPATH
BBPATH .= ":${LAYERDIR}"

# We have recipes-* directories, add to BBFILES
BBFILES += "${LAYERDIR}/recipes-*/*/*.bb \
            ${LAYERDIR}/recipes-*/*/*.bbappend"

BBFILE_COLLECTIONS += "meta-alif"
BBFILE_PATTERN_meta-alif = "^${LAYERDIR}/"
BBFILE_PRIORITY_meta-alif = "13"

LAYERDEPENDS_meta-alif = "core"
LAYERSERIES_COMPAT_meta-alif = "zeus"
ALIFBASE = '${@os.path.normpath("${LAYERDIR}/")}'
LICENSE_PATH += "${LAYERDIR}/licenses"
```

## conf/machine/appkit-e7.conf
```bitbake
# Copyright (C) 2022 Alif Semiconductor - All Rights Reserved.
# Use, distribution and modification of this code is permitted under the
# terms stated in the Alif Semiconductor Software License Agreement
#
# You should have received a copy of the Alif Semiconductor Software
# License Agreement with this file. If not, please write to:
# contact@alifsemi.com, or visit: https://alifsemi.com/license

require conf/machine/include/tune-cortex-a32.inc

DEFAULTTUNE = "cortexa32hf-neon"

# Use underscore "_" in platform name, - does not support
TF-A_PLATFORM = "devkit_e7"
BL32_IN_XIP_MEM ?= "1"
BL32_XIP_BASE ?= "0x80002000"
B0 ?= "0"
TRUSTED_SRAM0 ?= "0x02000000"
KERNEL_DTB_ADDR ?= "0x80010000"
KERNEL_MTD_START_ADDR ?= "0x80300000"
KERNEL_MTD_LEN ?= "0x200000"
A32_HWSEM_MST_ID ?= "0xA1B2C3D4"
A32_UART ??= "2"

TF-A_EXTRA_OPTIONS += " \
			RESET_TO_SP_MIN=1 \
			ARM_LINUX_KERNEL_AS_BL33=1 \
			ARM_TRUSTED_SRAM_BASE=${TRUSTED_SRAM0} \
			PLAT_ARM_TRUSTED_SRAM_BASE=${TRUSTED_SRAM0} \
			PRELOADED_BL33_BASE=${XIP_KERNEL_LOAD_ADDR} \
			ARM_PRELOADED_DTB_BASE=${KERNEL_DTB_ADDR} \
			ENABLE_STACK_PROTECTOR=strong \
			ENABLE_PIE=1 \
			BL32_IN_XIP_MEM=${BL32_IN_XIP_MEM} \
			BL32_XIP_BASE=${BL32_XIP_BASE} \
			B0=${B0} \
			UART=${A32_UART} \
			"
KERNEL_IMAGETYPE = "xipImage"
KERNEL_DEVICETREE = "appkit-e7.dtb"
KBUILD_DEFCONFIG = "appkit_e7_defconfig"

PREFERRED_PROVIDER_virtual/kernel = "linux-alif"

# needed for DCT tool
DTS_MACRO_FILE ?= "/arch/arm/boot/dts/devkit_ex_dct_defines.h"
DTS_MACRO_FILE_ORG ?= "/arch/arm/boot/dts/devkit_ex_dct_defines.h.org"

SERIAL_CONSOLES ?= "115200;ttyS0 115200;ttyS1 ${@bb.utils.contains('DISTRO_FEATURES', 'apss-debug', '', '115200;ttyS2 115200;ttyS3', d)}"
```

## conf/machine/bolt-fpga-b0.conf
```bitbake
require conf/machine/include/tune-cortex-a32.inc

DEFAULTTUNE = "cortexa32hf-neon"

# Use underscore "_" in platform name, - does not support
TF-A_PLATFORM = "bolt_fpga"
BL32_IN_XIP_MEM ?= "1"
BL32_XIP_BASE ?= "0x80002000"
A1 ?= "1"
TF-A_EXTRA_OPTIONS += " \
			RESET_TO_SP_MIN=1 \
			ARM_LINUX_KERNEL_AS_BL33=1 \
			ARM_TRUSTED_SRAM_BASE=${TRUSTED_SRAM0} \
			PLAT_ARM_TRUSTED_SRAM_BASE=${TRUSTED_SRAM0} \
			PRELOADED_BL33_BASE=${XIP_KERNEL_LOAD_ADDR} \
			ARM_PRELOADED_DTB_BASE=${KERNEL_DTB_ADDR} \
			ENABLE_STACK_PROTECTOR=strong \
			ENABLE_PIE=1 \
			BL32_IN_XIP_MEM=${BL32_IN_XIP_MEM} \
			BL32_XIP_BASE=${BL32_XIP_BASE} \
			A1=${A1} \
			"
KERNEL_IMAGETYPE = "xipImage"
KERNEL_DEVICETREE = "bolt_fpga_b0.dtb"
KBUILD_DEFCONFIG = "bolt_fpga_b0_defconfig"

TRUSTED_SRAM0 ?= "0x02000000"
KERNEL_DTB_ADDR ?= "0x8000A000"
KERNEL_MTD_START_ADDR ?= "0x80400000"
KERNEL_MTD_LEN ?= "0x200000"
A32_HWSEM_MST_ID ?= "0xA1B2C3D4"

PREFERRED_PROVIDER_virtual/kernel = "linux-alif"

SERIAL_CONSOLES ?= "115200;ttyS0 115200;ttyS1 ${@bb.utils.contains('DISTRO_FEATURES', 'apss-debug', '', '115200;ttyS2 115200;ttyS3', d)}"
```

## conf/machine/bolt-fpga.conf
```bitbake
require conf/machine/include/arm-common-configuration.inc
require conf/machine/include/tune-cortex-a32.inc

DEFAULTTUNE = "cortexa32-neon"

EXTRA_IMAGEDEPENDS_append = " boot-firmware external-system test-app"

TF-A_PLATFORM = "bolt_fpga"
TF-A_EXTRA_OPTIONS += " \
			RESET_TO_SP_MIN=1 \
			ARM_LINUX_KERNEL_AS_BL33=1 \
			ARM_TRUSTED_SRAM_BASE=0x02000000 \
			PRELOADED_BL33_BASE=0x80000000 \
			ARM_PRELOADED_DTB_BASE=0x02390000 \
			ENABLE_STACK_PROTECTOR=strong \
			ENABLE_PIE=1 \
			"
KERNEL_IMAGETYPE = "xipImage"
PREFERRED_PROVIDER_virtual/kernel = "linux-alif"
```

## conf/machine/bolt-rev-a0.conf
```bitbake
require conf/machine/include/tune-cortex-a32.inc

DEFAULTTUNE = "cortexa32-neon"

TRUSTED_SRAM0 ?= "0x02000000"
XIP_KERNEL_LOAD_ADDR ?= "0x08000000"
KERNEL_DTB_ADDR ?= "0x02390000"
KERNEL_MTD_START_ADDR ?= "0x80400000"
KERNEL_MTD_LEN ?= "0x200000"

# Use underscore "_" in platform name, - does not support
TF-A_PLATFORM = "bolt_rev_a0"
TF-A_EXTRA_OPTIONS += " \
			RESET_TO_SP_MIN=1 \
			ARM_LINUX_KERNEL_AS_BL33=1 \
			ARM_TRUSTED_SRAM_BASE=${TRUSTED_SRAM0} \
			PRELOADED_BL33_BASE=${XIP_KERNEL_LOAD_ADDR} \
			ARM_PRELOADED_DTB_BASE=${KERNEL_DTB_ADDR} \
			ENABLE_STACK_PROTECTOR=strong \
			ENABLE_PIE=1 \
			"
KERNEL_IMAGETYPE = "xipImage"
KERNEL_DEVICETREE = "bolt_rev_a0.dtb"

PREFERRED_PROVIDER_virtual/kernel = "linux-alif"

SERIAL_CONSOLES = "115200;ttyAMA0"
```

## conf/machine/devkit-e7.conf
```bitbake
require conf/machine/include/tune-cortex-a32.inc

DEFAULTTUNE = "cortexa32hf-neon"

# Use underscore "_" in platform name, - does not support
TF-A_PLATFORM = "devkit_e7"
TF-A_EXTRA_OPTIONS += " \
			RESET_TO_SP_MIN=1 \
			ARM_LINUX_KERNEL_AS_BL33=1 \
			ARM_TRUSTED_SRAM_BASE=${TRUSTED_SRAM0} \
			PRELOADED_BL33_BASE=${XIP_KERNEL_LOAD_ADDR} \
			ARM_PRELOADED_DTB_BASE=${KERNEL_DTB_ADDR} \
			ENABLE_STACK_PROTECTOR=strong \
			ENABLE_PIE=1 \
			"
KERNEL_IMAGETYPE = "xipImage"
KERNEL_DEVICETREE = "devkit-e7.dtb"
KBUILD_DEFCONFIG = "devkit_e7_defconfig"

TRUSTED_SRAM0 ?= "0x02000000"
KERNEL_DTB_ADDR ?= "0x02390000"
KERNEL_MTD_START_ADDR ?= "0xE0200000"
KERNEL_MTD_LEN ?= "0x200000"
A32_HWSEM_MST_ID ?= "0xA1B2C3D4"

PREFERRED_PROVIDER_virtual/kernel = "linux-alif"

SERIAL_CONSOLES = "115200;ttyS0 115200;ttyS1 115200;ttyS2 115200;ttyS3"
```

## recipes-kernel/linux/files/bolt-tiny/defconfig
```kconfig
CONFIG_PHYS_OFFSET=0x02200000
# CONFIG_LOCALVERSION_AUTO is not set
CONFIG_LOG_BUF_SHIFT=12
# CONFIG_UTS_NS is not set
# CONFIG_PID_NS is not set
# CONFIG_NET_NS is not set
CONFIG_BLK_DEV_INITRD=y
# CONFIG_LBDAF is not set
# CONFIG_BLK_DEV_BSG is not set
# CONFIG_IOSCHED_DEADLINE is not set
# CONFIG_IOSCHED_CFQ is not set
CONFIG_ARM_SINGLE_ARMV7A=y
CONFIG_ARCH_TINY_VEXPRESS=y
CONFIG_HAVE_ARM_ARCH_TIMER=y
CONFIG_THUMB2_KERNEL=y
CONFIG_ZBOOT_ROM_TEXT=0x0
CONFIG_ZBOOT_ROM_BSS=0x0
CONFIG_CMDLINE="console=ttyAMA0"
CONFIG_XIP_KERNEL=y
CONFIG_XIP_PHYS_ADDR=0x08500000
CONFIG_VFP=y
# CONFIG_CORE_DUMP_DEFAULT_ELF_HEADERS is not set
CONFIG_NET=y
CONFIG_PACKET=y
CONFIG_UNIX=y
CONFIG_INET=y
CONFIG_IP_PNP=y
CONFIG_IP_PNP_DHCP=y
CONFIG_IP_PNP_BOOTP=y
# CONFIG_IPV6 is not set
# CONFIG_WIRELESS is not set
CONFIG_DEVTMPFS=y
CONFIG_MTD=y
CONFIG_MTD_CFI=y
CONFIG_MTD_RAM=y
CONFIG_MTD_ROM=y
CONFIG_MTD_PHYSMAP=y
CONFIG_MTD_PHYSMAP_COMPAT=y
CONFIG_MTD_PHYSMAP_START=0x08100000
CONFIG_MTD_PHYSMAP_LEN=0x400000
CONFIG_EXTSYS_CTRL=y
CONFIG_NETDEVICES=y
CONFIG_SMC91X=y
CONFIG_SMSC911X=y
# CONFIG_WLAN is not set
# CONFIG_SERIO_SERPORT is not set
CONFIG_SERIAL_AMBA_PL011=y
CONFIG_SERIAL_AMBA_PL011_CONSOLE=y
CONFIG_RTC_CLASS=y
CONFIG_RTC_DRV_PL031=y
CONFIG_MAILBOX=y
CONFIG_ARM_MHUv2=y
CONFIG_RPMSG_CHAR=y
CONFIG_RPMSG_ARM=y
CONFIG_CRAMFS=y
CONFIG_CRAMFS_MTD=y
# CONFIG_CRYPTO_HW is not set
```

## wic/alif-tiny-image.bolt-fpga.wks
```
# Partition for corstone700

# Rawcopy of the FIP binary
part --source rawcopy --sourceparams="file=bolt_fpga.fip" --no-table --align 1 --fixed-size 991k

# Rawcopy of the rootfs
part --source rawcopy --sourceparams="file=${IMGDEPLOYDIR}/alif-tiny-image-bolt-fpga.cramfs-xip" --no-table --fixed-size 2

# Rawcopy of the kernel binary
part --source rawcopy --sourceparams="file=xipImage" --no-table --fixed-size 4
```
